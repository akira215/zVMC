## main/Kconfig.main
```kconfig
menu "OTA"
    config HARDWARE_VERSION
        int "Hardware version for OTA update"
        range 0 65535
        default 1
        help
            Hardware version for OTA update.
    
    config MAX_DATA_SIZE
        int "The maximum size of OTA data"
        range 0 255
        default 200
        help
            The maximum size of OTA data

    config OTA_TIMER_QUERY
        int "Time between OTA queries in minutes"
        range 0 65535
        #default 1440
        default 1
        help
            The field indicates the time of querying OTA image for OTA upgrade client
endmenu

menu "ALDES VMC"

    config VMC_POLLING_MS
        int "Polling delay for VMC"
        range 1000 3600000
        default 5000
        help
            Delay between 2 queries to VMC device

endmenu

menu "Pin layout"
    config PIN_LED
        int "On Board LED GPIO Num"
        range ENV_GPIO_RANGE_MIN ENV_GPIO_OUT_RANGE_MAX
        default 23
        help
            GPIO number for Led that App will use as UI.
    
    config PIN_BUTTON
        int "On Board Button GPIO Num"
        range ENV_GPIO_RANGE_MIN ENV_GPIO_OUT_RANGE_MAX
        default 9
        help
            GPIO number for the button that App will use as UI.
    
endmenu

menu "Zigbee specific"
     config MANUF_CODE
        int "Manufacturer code for custom attributes"
        range 0 65535
        default 26518
        help
           This code shall not interfer with other zigbee devices.

endmenu

menu "Zigbee endpoints"
     config GENERAL_EP
        int "General device Endpoint"
        range 0 1024
        default 1
        help
           Zigbee general endpoint for the device.

    config INTAKE_OUT_EP
        int "Out Air Intake Endpoint"
        range 0 1024
        default 2
        help
           Zigbee endpoint for Air input.
    
    config EXTRACT_IN_EP
        int "Interior Air extraction Endpoint"
        range 0 1024
        default 3
        help
            Zigbee endpoint for Air Interior.
    
    config SUPPLY_IN_EP
        int "Interior Air supply Endpoint"
        range 0 1024
        default 4
        help
            Zigbee endpoint for air supply pressure.

    config EXHAUST_OUT_EP
        int "Out Air Exhaust Endpoint"
        range 0 1024
        default 5
        help
            Zigbee endpoint for air exhaust.

endmenu
```
